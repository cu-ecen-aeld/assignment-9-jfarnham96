## base_external/Config.in
```kconfig
# From hello world example
source "$BR2_EXTERNAL_project_base_PATH/package/aesd-assignments/Config.in"
source "$BR2_EXTERNAL_project_base_PATH/package/ldd/Config.in"
source "$BR2_EXTERNAL_project_base_PATH/package/aesd-char-and-server/Config.in"
```
